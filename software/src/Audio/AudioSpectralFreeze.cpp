// AudioSpectralFreeze.cpp
// Phase Vocoder Spectral Freeze — DSP implementation
//
// MIT License — (c) 2026 Andy Jenkinson (uglifruit) with ClaudeCode

#include "AudioSpectralFreeze.h"
#include <arm_math.h>

// =============================================================================
// Hann window LUT — 1024 points, stored in Flash (PROGMEM) to save OCRAM.
//
// w[i] = 0.5 * (1 - cos(2π·i / 1023))   for i = 0 … 1023
//
// Generated with:
//   node -e "const v=Array.from({length:1024},(_,i)=>0.5*(1-Math.cos(2*Math.PI*i/1023)));
//            for(let i=0;i<1024;i+=8)process.stdout.write('  '+v.slice(i,i+8).map(x=>x.toFixed(8)+'f').join(', ')+',\n');"
// =============================================================================
PROGMEM static const float hann_lut[AudioSpectralFreeze::FFT_SIZE] = {
    0.00000000f, 0.00000943f, 0.00003772f, 0.00008487f, 0.00015089f, 0.00023575f, 0.00033947f, 0.00046204f,
    0.00060345f, 0.00076370f, 0.00094278f, 0.00114069f, 0.00135742f, 0.00159296f, 0.00184730f, 0.00212043f,
    0.00241234f, 0.00272303f, 0.00305247f, 0.00340066f, 0.00376758f, 0.00415322f, 0.00455757f, 0.00498060f,
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    0.00046204f, 0.00033947f, 0.00023575f, 0.00015089f, 0.00008487f, 0.00003772f, 0.00000943f, 0.00000000f,
};

// =============================================================================
// Synthesis Hann window LUT, pre-scaled by the OLA normalisation factor.
//
// hann_norm_lut[i] = hann_lut[i] * (1.0 / (FFT_SIZE * 0.375))
//                  = hann_lut[i] / 384.0
//
// Storing the product in Flash means the synthesis pass (step 7) is a single
// arm_vmul_f32 call with no per-sample runtime multiply by the norm constant.
// =============================================================================
PROGMEM static const float hann_norm_lut[AudioSpectralFreeze::FFT_SIZE] = {
    0.0000000000f, 0.0000000246f, 0.0000000982f, 0.0000002210f, 0.0000003929f, 0.0000006139f, 0.0000008840f, 0.0000012032f,
    0.0000015715f, 0.0000019888f, 0.0000024552f, 0.0000029706f, 0.0000035349f, 0.0000041483f, 0.0000048107f, 0.0000055220f,
    0.0000062821f, 0.0000070912f, 0.0000079491f, 0.0000088559f, 0.0000098114f, 0.0000108157f, 0.0000118687f, 0.0000129703f,
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    0.0000012032f, 0.0000008840f, 0.0000006139f, 0.0000003929f, 0.0000002210f, 0.0000000982f, 0.0000000246f, 0.0000000000f,
};

// =============================================================================
// Constructor
// =============================================================================
AudioSpectralFreeze::AudioSpectralFreeze()
    : AudioStream(1, input_queue_array)
{
    // Initialise the 1024-point real FFT instance.
    // arm_rfft_fast_init_f32 populates rfft_inst with pointers to CMSIS twiddle
    // tables held in ROM — no heap allocation occurs.
    arm_status status = arm_rfft_fast_init_f32(&rfft_inst, FFT_SIZE);
    rfft_ready = (status == ARM_MATH_SUCCESS);
}

// =============================================================================
// fastRand — XORshift32 PRNG scaled to [-π, π]
//
// A 32-bit XORshift is roughly 4× faster than the Arduino random() function
// and avoids any global state mutation. Used for per-bin random phase when
// Smear > 0 in frozen mode.
// =============================================================================
float AudioSpectralFreeze::fastRand() {
    prng_state ^= prng_state << 13;
    prng_state ^= prng_state >> 17;
    prng_state ^= prng_state << 5;
    // Map uint32 to [-π, π]
    return (static_cast<float>(prng_state) / 2147483648.0f - 1.0f) * 3.14159265f;
}

// =============================================================================
// processFrame — called every HOP_SIZE (256) samples from update()
//
// Pipeline:
//   1. Unroll circular input_buf into fft_buf (two arm_copy_f32 calls)
//   2. Apply analysis Hann window (arm_vmul_f32 with hann_lut[])
//   3. arm_rfft_fast_f32 forward transform (real-valued, in-place)
//   4. Freeze edge detection: capture raw complex (re, im) on false→true edge
//      — no sqrtf, no atan2f
//   5. Spectrum processing:
//        not frozen → pass complex output unchanged (perfect OLA reconstruction)
//        frozen, smear=0 → direct copy of frozen_re/frozen_im, zero trig
//        frozen, smear=1 → random direction, original magnitude (arm_sqrt_f32 + sin/cos)
//        frozen, blend   → lerp between frozen direction and random (arm_sqrt_f32 + sin/cos)
//   6. arm_rfft_fast_f32 inverse transform (in-place)
//   7. Synthesis window + normalisation: arm_vmul_f32 with hann_norm_lut[]
//   8. OLA accumulation: two arm_add_f32 calls; advance ola_write by HOP_SIZE
// =============================================================================
void AudioSpectralFreeze::processFrame() {
    if (!rfft_ready) return;

    // --- Step 1: Unroll circular input ring into a linear array for the FFT ---
    // input_write is the next-write slot; oldest sample is at input_write.
    // Split into at most two arm_copy_f32 calls to avoid per-element masking.
    {
        const int src  = input_write;
        const int tail = FFT_SIZE - src;   // samples from src to end of buffer
        arm_copy_f32(input_buf + src, fft_buf,        tail);
        arm_copy_f32(input_buf,       fft_buf + tail, FFT_SIZE - tail);
    }

    // --- Step 2: Analysis window (Hann) ---
    // arm_vmul_f32 multiplies two float vectors element-wise using SIMD.
    // hann_lut lives in Flash; reading it here is safe (it's const, no DMA).
    arm_vmul_f32(fft_buf, hann_lut, fft_buf, FFT_SIZE);

    // --- Step 3: Forward real FFT ---
    // arm_rfft_fast_f32(instance, input, output, direction)
    //   direction=0 → forward transform
    // Output packed-real layout:
    //   fft_buf[0]          = DC  (real)
    //   fft_buf[1]          = Nyquist (real)
    //   fft_buf[2k], [2k+1] = real, imag of complex bin k   (k = 1 … 511)
    arm_rfft_fast_f32(&rfft_inst, fft_buf, fft_buf, 0);

    // --- Step 4 & 5: Spectral processing ---
    const bool freeze_edge = (frozen && !was_frozen);

    if (frozen) {
        // Capture magnitudes and phases on the first frozen frame
        if (freeze_edge) {
            // DC and Nyquist are real-only — store raw values (sign preserved).
            // Complex bins 1…511: store raw (re, im) so smear=0 synthesis needs
            // no trig at all, and atan2f is never called.
            frozen_re[0]   = fft_buf[0];  // DC
            frozen_re[512] = fft_buf[1];  // Nyquist
            for (int k = 1; k < 512; ++k) {
                frozen_re[k] = fft_buf[2 * k];
                frozen_im[k] = fft_buf[2 * k + 1];
            }
        }

        // Rebuild complex spectrum from frozen coefficients.
        // fft_buf is overwritten here ready for the IFFT.
        fft_buf[0] = frozen_re[0];    // DC
        fft_buf[1] = frozen_re[512];  // Nyquist

        if (smear <= 0.0f) {
            // --- smear=0: direct copy, zero trig ---
            for (int k = 1; k < 512; ++k) {
                fft_buf[2 * k]     = frozen_re[k];
                fft_buf[2 * k + 1] = frozen_im[k];
            }
        } else if (smear >= 1.0f) {
            // --- smear=1: fully random direction, original magnitude ---
            // arm_sqrt_f32 uses the same Cortex-M7 VSQRT instruction as sqrtf.
            for (int k = 1; k < 512; ++k) {
                const float re = frozen_re[k], im = frozen_im[k];
                float mag;
                arm_sqrt_f32(re * re + im * im, &mag);
                const float rnd = fastRand();
                fft_buf[2 * k]     = mag * arm_cos_f32(rnd);
                fft_buf[2 * k + 1] = mag * arm_sin_f32(rnd);
            }
        } else {
            // --- blend: lerp between frozen direction and random direction ---
            for (int k = 1; k < 512; ++k) {
                const float re = frozen_re[k], im = frozen_im[k];
                float mag;
                arm_sqrt_f32(re * re + im * im, &mag);
                if (mag > 0.0f) {
                    const float inv    = 1.0f / mag;
                    const float rnd    = fastRand();
                    const float re_n   = re * inv + smear * (arm_cos_f32(rnd) - re * inv);
                    const float im_n   = im * inv + smear * (arm_sin_f32(rnd) - im * inv);
                    fft_buf[2 * k]     = mag * re_n;
                    fft_buf[2 * k + 1] = mag * im_n;
                } else {
                    fft_buf[2 * k]     = 0.0f;
                    fft_buf[2 * k + 1] = 0.0f;
                }
            }
        }
    }
    // else: not frozen → fft_buf already contains the live complex spectrum;
    // pass it directly to the IFFT for perfect OLA reconstruction.

    was_frozen = frozen;

    // --- Step 6: Inverse real FFT ---
    // direction=1 → inverse transform
    // Output is a 1024-point real time-domain frame in fft_buf.
    arm_rfft_fast_f32(&rfft_inst, fft_buf, fft_buf, 1);

    // --- Step 7: Synthesis window + OLA normalisation ---
    // hann_norm_lut[i] = hann[i] / (FFT_SIZE * 0.375) — pre-scaled in Flash.
    // arm_vmul_f32 applies the window and normalisation in one SIMD pass.
    arm_vmul_f32(fft_buf, hann_norm_lut, fft_buf, FFT_SIZE);

    // --- Step 8: Overlap-Add accumulation ---
    // Split into at most two arm_add_f32 calls to avoid per-element masking.
    // OLA_SIZE=2048, FFT_SIZE=1024, ola_write is a multiple of HOP_SIZE=256,
    // so the write wraps at most once.
    {
        const int tail = OLA_SIZE - ola_write;  // slots from ola_write to end
        if (tail >= FFT_SIZE) {
            arm_add_f32(ola_buf + ola_write, fft_buf, ola_buf + ola_write, FFT_SIZE);
        } else {
            arm_add_f32(ola_buf + ola_write, fft_buf,        ola_buf + ola_write, tail);
            arm_add_f32(ola_buf,             fft_buf + tail, ola_buf,             FFT_SIZE - tail);
        }
    }
    ola_write = (ola_write + HOP_SIZE) & (OLA_SIZE - 1);
}

// =============================================================================
// update() — called by the Teensy audio ISR every AUDIO_BLOCK_SAMPLES (128)
//
// 1. Receive input block, convert q15 → float, push into input ring buffer.
// 2. Every HOP_SIZE (256) samples: trigger processFrame().
// 3. Drain AUDIO_BLOCK_SAMPLES samples from the OLA output ring, convert to q15,
//    transmit on channel 0.
//    The OLA slots are zeroed after reading so they are ready for the next
//    accumulation pass.
// =============================================================================
void AudioSpectralFreeze::update() {
    audio_block_t* in = receiveReadOnly(0);
    audio_block_t* out = allocate();
    if (!out) {
        if (in) release(in);
        return;
    }

    // --- Ingest incoming samples into the input circular ring ---
    // fft_buf[] is idle between processFrame() calls — reuse its first
    // AUDIO_BLOCK_SAMPLES floats as a temporary, avoiding stack allocation.
    if (in) {
        // arm_q15_to_float scales by 1/32768 → [-1, 1].
        const int space = FFT_SIZE - input_write;  // slots before ring end
        if (space >= AUDIO_BLOCK_SAMPLES) {
            // No wrap: convert directly into the ring.
            arm_q15_to_float(in->data, input_buf + input_write, AUDIO_BLOCK_SAMPLES);
        } else {
            // Wrap: convert into fft_buf, then copy in two chunks.
            arm_q15_to_float(in->data, fft_buf, AUDIO_BLOCK_SAMPLES);
            arm_copy_f32(fft_buf,         input_buf + input_write, space);
            arm_copy_f32(fft_buf + space, input_buf,               AUDIO_BLOCK_SAMPLES - space);
        }
        release(in);
    } else {
        // No input block — fill ring with silence so OLA timing stays correct.
        const int space = FFT_SIZE - input_write;
        if (space >= AUDIO_BLOCK_SAMPLES) {
            arm_fill_f32(0.0f, input_buf + input_write, AUDIO_BLOCK_SAMPLES);
        } else {
            arm_fill_f32(0.0f, input_buf + input_write, space);
            arm_fill_f32(0.0f, input_buf,               AUDIO_BLOCK_SAMPLES - space);
        }
    }
    input_write = (input_write + AUDIO_BLOCK_SAMPLES) & (FFT_SIZE - 1);

    // --- Check whether a new FFT frame is due ---
    hop_counter += AUDIO_BLOCK_SAMPLES;
    if (hop_counter >= HOP_SIZE) {
        hop_counter -= HOP_SIZE;
        processFrame();
    }

    // --- Drain output from the OLA ring, convert float → q15, transmit ---
    // Reuse fft_buf[] as the output staging buffer (same rationale as above).
    // OLA_SIZE=2048, AUDIO_BLOCK_SAMPLES=128 — wraps at most once.
    {
        const int tail = OLA_SIZE - ola_read;
        if (tail >= AUDIO_BLOCK_SAMPLES) {
            arm_copy_f32(ola_buf + ola_read, fft_buf, AUDIO_BLOCK_SAMPLES);
            arm_fill_f32(0.0f, ola_buf + ola_read, AUDIO_BLOCK_SAMPLES);
        } else {
            arm_copy_f32(ola_buf + ola_read, fft_buf,        tail);
            arm_copy_f32(ola_buf,            fft_buf + tail, AUDIO_BLOCK_SAMPLES - tail);
            arm_fill_f32(0.0f, ola_buf + ola_read, tail);
            arm_fill_f32(0.0f, ola_buf,            AUDIO_BLOCK_SAMPLES - tail);
        }
    }
    ola_read = (ola_read + AUDIO_BLOCK_SAMPLES) & (OLA_SIZE - 1);

    // arm_float_to_q15 clips to [-1, 1] and scales by 32767
    arm_float_to_q15(fft_buf, out->data, AUDIO_BLOCK_SAMPLES);
    transmit(out);
    release(out);
}
